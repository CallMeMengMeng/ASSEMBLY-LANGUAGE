; CALCULATE THE POLYNOMIAL WITH SIGNED NUMBERS (Z-(X*Y+200))/20, STORE THE QUOTIENT IN V AND THE REMAINDER IN W

DATA	SEGMENT
X	DW	2
Y	DW	-10
Z	DW	200					; CALCULATE (200-(2*(-10)+200))/20
V	DW	0					; STORE QUOTIENT HERE
W	DW	0					; STORE REMAINDER HERE
DATA	ENDS

CODE	SEGMENT
ASSUME	DS:DATA,CS:CODE
START:	MOV AX,DATA
		MOV DS,AX
		MOV AX,X
		MOV BX,Y
		IMUL BX				; DX:AX=X*Y
		MOV BX,0
		MOV CX,200
		ADD AX,CX
		ADC DX,BX			; DX:AX=X*Y+200
		MOV CX,Z			; CX=200
		MOV BX,0
		SUB CX,AX
		SBB BX,DX			; BX:CX=200-(X*Y+200)
		XCHG CX,AX
		XCHG BX,DX			; DX:AX=200-(X*Y+200)
		MOV BX,20
		IDIV BX				; DX:AX=(200-(X*Y+200))/20, AX=QUOTIENT AND DX=REMAINDER
		MOV V,AX			; STORE QUOTIENT IN V
		MOV W,DX			; STORE	REMAINDER IN W
		MOV AH,4CH
		INT 21H
CODE	ENDS
		END START