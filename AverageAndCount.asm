; THERE ARE 100H 16-BIT COMPLEMENT NUMBERS STORED IN THE WORD ARRAY WITH THE FIRST ADDRESS AS DATA.
; TRY TO FIND THEIR AVERAGE VALUE AND PUT IT IN AX, AND FIGURE OUT HOW MANY NUMBERS IN THE ARRAY ARE 
; LESS THAN THIS AVERAGE VALUE, THEN PUT IT IN BX.

DATAS	SEGMENT
DATA	DW	80H DUP(-1),80H DUP(3)
LEN		EQU	($-DATA)/2
DATAS	ENDS

CODE	SEGMENT
ASSUME	CS:CODE,DS:DATAS
START:	MOV AX,DATAS
		MOV DS,AX  
		
		LEA SI,DATA
		MOV AX,0
		MOV CX,LEN
		MOV DX,0
						; SUM ALL THE NUMBERS:
						; IF IT IS GREAT THAN 0 (OR EQUALS TO 0), THEN AX ADD IT, DX ADC 0
						; IF IT IS LESS THAN 0, THEN AX SUB IT, DX SBB 0
SUM:	MOV BX,[SI]
		CMP BX,0
		JL  NEGAT
		ADD AX,BX
		ADC DX,0
		JMP NEXT
NEGAT:  NEG BX
        SUB AX,BX
        SBB DX,0
NEXT:   ADD SI,2
        LOOP SUM
						; CALCULATE THE AVERAGE VALUE
AVER:	MOV CX,LEN
		DIV CX
						; COMPARE [SI] WITH AVERAGE:
						; IF [SI] IS LESS THAN AVERAGE, BX++ 
		LEA SI,DATA
		MOV BX,0
AGAIN:	CMP [SI],AX
		JNL LARGER
		INC BX
LARGER:	ADD SI,2
		LOOP AGAIN
		HLT
CODE	ENDS
		END START