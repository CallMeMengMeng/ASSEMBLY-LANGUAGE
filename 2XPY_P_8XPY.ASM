; THERE ARE THREE PARAMETERS X Y Z IN THE DATA SEGMENT, AND X=8,Y=9,
; USE SHIFT COMMAND TO CALCULATE "(X+Y)*2+(X+Y)*8"

DATA	SEGMENT
X	DW	8
Y	DW	9
Z	DW	(0)
DATA	ENDS

CODE	SEGMENT
ASSUME	DS:DATA,CS:CODE
START:	MOV AX,DATA
		MOV DS,AX
		MOV AX,X
		MOV	BX,Y
		ADD	AX,BX	; X+Y
		SHL AX,1	; (X+Y)*2
		MOV	BX,AX
		MOV CL,2
		SHL	AX,CL	; (X+Y)*8
		ADC	AX,BX
		MOV Z,AX    
		; PRINT THE RESULT ON THE SCREEN IN BINARY
		MOV BX,Z	; TRANSMIT THE RESULT TO BX
		MOV CX,16 	; SET A COUNTER(THE RESULT IS LESS THAN 65535)
AGAIN:      
        ROL BX,1	; ROTATE THE FIRST BINARY NUMBER TO THE LAST EACH TIME
        MOV DX,BX	; MOV BX TO DX SO AS TO PROTECT THE NUMBER IN BX
        AND DX,01H	; SAVE THE LAST BIT MERELY
        ADD DX,30H	; DISPLAY THE LAST BIT IN ASCII 'CAUSE THE ASCII OF 0 IS 30H
        MOV AH,02H	; DISPLAY
        INT 21H		; DISPLAY
        LOOPNZ AGAIN
CODE	ENDS
		END START